## main/Kconfig.projbuild
```kconfig
menu "DockPulse"

    choice DOCKPULSE_ROLE
        prompt "Node role"
        default DOCKPULSE_ROLE_SENSOR
        help
            Select whether this firmware image is a battery/solar-powered
            sensor node (one per berth) or the mains-powered gateway.

        config DOCKPULSE_ROLE_SENSOR
            bool "Sensor (solar, deep sleep, mmWave radar)"

        config DOCKPULSE_ROLE_GATEWAY
            bool "Gateway (mains, always on, uplink)"
    endchoice

    config DOCKPULSE_NODE_ID
        int "Node ID (legacy/bench fallback)"
        range 1 8
        default 1
        help
            Sensor `node_id` payload field + bench-mode berth-id index
            (1..12 -> t1..t4 / l1..l4 / r1..r4). After QR provisioning
            the unicast addr is assigned by PB-ADV and the berth id
            comes from the gateway dp_prov table.

    config DOCKPULSE_LED_GPIO
        int "Status LED GPIO (-1 to disable)"
        default 8
        help
            Waveshare ESP32-C3-Zero onboard WS2812 RGB is GPIO 8.
            Plain LED on a C3 SuperMini is also GPIO 8 (active-low).

    config DOCKPULSE_LED_WS2812
        bool "LED is WS2812 (addressable RGB)"
        default y
        help
            Drive via led_strip RMT, map states to colors (green=ok,
            blue=provisioning, red=error). Off = plain GPIO via
            gpio_set_level.

    config DOCKPULSE_LED_ACTIVE_LOW
        bool "Plain-LED active-low (ignored when WS2812)"
        default y
        depends on !DOCKPULSE_LED_WS2812

    config DOCKPULSE_FACTORY_RESET_GPIO
        int "Factory-reset button GPIO (-1 to disable)"
        default 9
        help
            GPIO 9 = BOOT button on most C3 devkits. Long-press at
            runtime; doesn't collide with bootloader strap.

    config DOCKPULSE_FACTORY_RESET_HOLD_MS
        int "Long-press hold time (ms)"
        default 5000

    config DOCKPULSE_BATTERY_ADC_GPIO
        int "Battery-sense ADC GPIO (-1 to disable)"
        range -1 4
        default -1
        help
            ADC1 channel pin reading battery voltage through a 1:1
            divider (R1=R2=100k). ESP32-C3 ADC1 channels: GPIO 0..4
            = CH0..CH4. ADC2 is unusable while Wi-Fi/BLE is active.
            Leave -1 on boards without the divider (gateway, bench).

    menu "Sensor"
        depends on DOCKPULSE_ROLE_SENSOR

        config DOCKPULSE_RADAR_FAKE
            bool "Use fake radar (no hardware required)"
            default n
            help
                When enabled, dp_radar_read() returns synthetic samples
                instead of talking to the HMMD module over UART. Useful
                for bench-testing the mesh / gateway / MQTT path on a
                bare ESP32-C3 with no sensor attached. The fake walks
                the distance from 200 cm to 780 cm in a 30-sample cycle
                and toggles `presence` accordingly.

        config DOCKPULSE_RADAR_UART_PORT
            depends on !DOCKPULSE_RADAR_FAKE
            int "Radar UART port number"
            range 0 1
            default 1

        config DOCKPULSE_RADAR_UART_TX
            int "Radar UART TX GPIO"
            depends on !DOCKPULSE_RADAR_FAKE
            default 4

        config DOCKPULSE_RADAR_UART_RX
            int "Radar UART RX GPIO"
            depends on !DOCKPULSE_RADAR_FAKE
            default 5

        config DOCKPULSE_RADAR_UART_BAUD
            int "Radar UART baud rate"
            depends on !DOCKPULSE_RADAR_FAKE
            default 115200

        config DOCKPULSE_SENSOR_PERIOD_MS
            int "Sensor sample period (ms)"
            default 60000
            help
                Wake interval between mmWave samples on sensor nodes.

        config DOCKPULSE_DIAG_ENABLE
            bool "Publish raw radar diagnostics over mesh"
            default y
            help
                Send a berth_diag_t (target state, raw distance, 16
                gate energies) alongside each status; gateway forwards
                it on harbor/.../diag. Disable to save mesh airtime
                / solar power.

        menu "Proximity"

            config DOCKPULSE_PROXIMITY_CM
                int "Proximity threshold (cm)"
                range 1 1000
                default 30
                help
                    Berth reports `occupied` when the radar measures a
                    target closer than this. The HMMD's distance
                    estimator is reliable in the near field (high SNR),
                    so a simple distance threshold is enough — no
                    background subtraction or gate-energy filtering
                    needed.

            config DOCKPULSE_PROXIMITY_STABILITY_FRAMES
                int "Consecutive in-range frames required"
                range 1 16
                default 2
                help
                    Suppresses single-frame jitter. At the 200 ms read
                    cadence, 2 frames is ~400 ms.

        endmenu
    endmenu

    menu "Gateway"
        depends on DOCKPULSE_ROLE_GATEWAY

        config DOCKPULSE_GATEWAY_UPLINK_STUB
            bool "Use uplink stub (log only)"
            default y
            help
                When enabled the gateway logs samples to UART instead of
                forwarding upstream. Disable when wiring real backend.

        config DOCKPULSE_WIFI_SSID
            string "Wi-Fi SSID"
            depends on !DOCKPULSE_GATEWAY_UPLINK_STUB
            default ""

        config DOCKPULSE_WIFI_PASSWORD
            string "Wi-Fi password"
            depends on !DOCKPULSE_GATEWAY_UPLINK_STUB
            default ""

        config DOCKPULSE_MQTT_BROKER_URI
            string "MQTT broker URI"
            depends on !DOCKPULSE_GATEWAY_UPLINK_STUB
            default "mqtts://mqtt.dockpulse.xyz:8883"
            help
                Broker URI. Use mqtts:// for TLS / mTLS (prod), or
                mqtt:// for plaintext local development. When TLS is
                enabled below, the scheme must be mqtts:// and the
                broker must present a publicly trusted server cert
                (Let's Encrypt in our prod stack).

        config DOCKPULSE_MQTT_TLS
            bool "Use TLS + client cert (mTLS)"
            depends on !DOCKPULSE_GATEWAY_UPLINK_STUB
            default y
            select MBEDTLS_CERTIFICATE_BUNDLE
            help
                Enables mqtts:// transport, server verification via the
                ESP-IDF Mozilla CA bundle, and client authentication
                using a per-device cert + key embedded into the
                firmware at build time. Place the files at
                  certs/client.crt
                  certs/client.key
                The cert's CN becomes the gateway's MQTT username; it
                must be issued by the device CA in the dockpulse repo's
                cert-tools (`gen_certs.sh device <id>`). When this is
                off the gateway connects in plaintext on mqtt://, only
                useful with a local broker on a trusted network.

        config DOCKPULSE_HARBOR_ID
            string "Harbor identifier (topic segment)"
            depends on !DOCKPULSE_GATEWAY_UPLINK_STUB
            default "main"
            help
                Used as the {harbor_id} segment of the MQTT topic.
                Topic format is harbor/{harbor_id}/{dock_id}/{berth_id}/status
                per docs/api/mqtt-contract.yml in the dockpulse repo.

        config DOCKPULSE_DOCK_ID
            string "Dock identifier (topic segment)"
            depends on !DOCKPULSE_GATEWAY_UPLINK_STUB
            default "dock-a"
            help
                Used as the {dock_id} segment of the MQTT topic.

        config DOCKPULSE_GATEWAY_ID
            string "Gateway ID (adoption topic segment)"
            depends on !DOCKPULSE_GATEWAY_UPLINK_STUB
            default "gw-001"
            help
                Used in dockpulse/v1/gw/{gw_id}/{...} topics for the
                adoption protocol (provision/req, provision/resp,
                status). Must match a row in the backend's gateways
                table; the backend rejects requests for unknown ids.

        config DOCKPULSE_BERTH_ID_FORMAT
            string "Berth ID format (printf %s = suffix)"
            depends on !DOCKPULSE_GATEWAY_UPLINK_STUB
            default "ksss-saltsjobaden-pier-1-%s"
            help
                Format string used to build a contract-shape berth_id
                from the integer carried in the BLE Mesh berth_status_t.
                The single %s is replaced with a suffix from the
                seed-defined order: nodes 1..4 -> t1..t4, 5..8 ->
                l1..l4, 9..12 -> r1..r4. The result must match a
                berth_id row in the backend's berths table or the
                backend will drop the publish as "Unknown berth".

        config DOCKPULSE_MQTT_QOS
            int "MQTT publish QoS"
            depends on !DOCKPULSE_GATEWAY_UPLINK_STUB
            range 0 2
            default 1

        config DOCKPULSE_MQTT_CLIENT_ID
            string "MQTT client ID (empty = chip-derived)"
            depends on !DOCKPULSE_GATEWAY_UPLINK_STUB
            default ""

        config DOCKPULSE_MQTT_KEEPALIVE_S
            int "MQTT keepalive (seconds)"
            depends on !DOCKPULSE_GATEWAY_UPLINK_STUB
            range 10 600
            default 30
            help
                ESP-IDF defaults to 120s; carrier NAT typically drops idle
                TCP at 60-90s so the keepalive ping never gets sent. 30s is
                low enough to survive most NATs while keeping idle traffic
                modest. Bump for stable wired uplinks if log volume matters.

        config DOCKPULSE_MQTT_SELFTEST
            bool "Publish a synthetic sample after broker connect"
            depends on !DOCKPULSE_GATEWAY_UPLINK_STUB
            default n
            help
                Emit one fake berth_status_t to the configured topic
                once MQTT connects. Useful for end-to-end smoke tests
                before the mesh receive path is wired up. Leave off in
                production.
    endmenu

endmenu
```

## sdkconfig.defaults
```kconfig
# Target
CONFIG_IDF_TARGET="esp32c3"

# Bluetooth + NimBLE host (no NimBLE-mesh — its FreeRTOS port is
# incomplete: per-buffer adv events are never ble_npl_event_init'd and
# the legacy adv worker is gated #ifdef MYNEWT, so the first publish
# crashes). We use Espressif's esp_ble_mesh stack instead — same
# Bluetooth Mesh on the wire, but a thoroughly-tested implementation
# that also runs on the NimBLE host.
CONFIG_BT_ENABLED=y
CONFIG_BT_NIMBLE_ENABLED=y
# CONFIG_BT_NIMBLE_MESH is not set

# esp_ble_mesh — node + provisioner, both enabled. We use the
# provisioner role to self-configure each device's local keys/bindings;
# we never on-board another device over the air.
CONFIG_BLE_MESH=y
CONFIG_BLE_MESH_NODE=y
CONFIG_BLE_MESH_PROVISIONER=y
CONFIG_BLE_MESH_PB_ADV=y
# cfg client used by gateway to push AppKey + Model App Bind + Model Pub Set
# to a freshly provisioned sensor. Linked on sensor too (unused there) so a
# single image config covers both roles.
CONFIG_BLE_MESH_CFG_CLI=y
# CONFIG_BLE_MESH_PB_GATT is not set
# CONFIG_BLE_MESH_GATT_PROXY_SERVER is not set
CONFIG_BLE_MESH_RELAY=y
CONFIG_BLE_MESH_USE_DUPLICATE_SCAN=y
# Default 1 saturates fast when publishes overlap. 10 matches the
# vendor_models example and gives plenty of headroom even at <1s
# publish cadence.
CONFIG_BLE_MESH_TX_SEG_MSG_COUNT=10
CONFIG_BLE_MESH_RX_SEG_MSG_COUNT=10

# Persist subnet, app keys, model bindings, and the per-source sequence
# counter to NVS. Without this the sensor restarts seq at 0 after every
# power cycle and the gateway's replay-protection list rejects the
# resulting low-seq packets as replays — silent data loss for any
# sensor that legitimately reboots (deep sleep, brown-out, hard
# repower).
CONFIG_BLE_MESH_SETTINGS=y

# Logging — keep app default at INFO (USB-Serial-JTAG drops bytes when
# no host attached, so verbose logs don't stall the publish loop).
# Bootloader to WARNING to shave ~80ms off cold boot and silence the
# header dump that's noise once a fleet is in the field.
CONFIG_LOG_DEFAULT_LEVEL_INFO=y
CONFIG_LOG_COLORS=y
CONFIG_BOOTLOADER_LOG_LEVEL_WARN=y
# silence the ROM bootloader's UART chatter on every reset / wake
# CONFIG_BOOT_ROM_LOG_ALWAYS_ON is not set
CONFIG_BOOT_ROM_LOG_ALWAYS_OFF=y

# Route the console to USB-Serial-JTAG instead of UART0. UART0's TX
# FIFO blocks the writer task when no host is reading; the sensor's
# per-cycle ESP_LOGI calls (including the RADAR CSV trace) hang the
# publish loop until tools/monitor.sh opens the port. USB-Serial-JTAG
# drops bytes silently when no host is attached, so the application
# task keeps running.
# CONFIG_ESP_CONSOLE_UART_DEFAULT is not set
CONFIG_ESP_CONSOLE_USB_SERIAL_JTAG=y

# NimBLE GAP logs every advertise stop/start at INFO. The mesh stack
# cycles these every ~100ms so they drown the application logs.
# Drop NimBLE itself to WARNING; our `dp_mesh:` lines stay at INFO.
# CONFIG_BT_NIMBLE_LOG_LEVEL_INFO is not set
CONFIG_BT_NIMBLE_LOG_LEVEL_WARNING=y

# NVS for persistent state (mesh provisioning, calibration)
CONFIG_NVS_ENCRYPTION=n

# Power: defaults; per-role overrides in main/Kconfig.projbuild
CONFIG_PM_ENABLE=y
CONFIG_FREERTOS_USE_TICKLESS_IDLE=y

# Flash + partitioning (assumes 4MB module — ESP32-C3 SuperMini etc.)
CONFIG_ESPTOOLPY_FLASHSIZE_4MB=y
CONFIG_ESPTOOLPY_FLASHSIZE="4MB"
CONFIG_PARTITION_TABLE_CUSTOM=y
CONFIG_PARTITION_TABLE_CUSTOM_FILENAME="partitions.csv"

# Compiler
CONFIG_COMPILER_OPTIMIZATION_SIZE=y
CONFIG_COMPILER_WARN_WRITE_STRINGS=y

# Production hardening. Kept here (not in per-role sdkconfig) so every
# build that consumes sdkconfig.defaults inherits them.
#
# auto-reboot on panic — unattended devices in the field can't be
# manually power-cycled. paired with TASK/INT/BOOTLOADER WDTs and
# stack-canary checks already on by default
CONFIG_ESP_SYSTEM_PANIC_PRINT_REBOOT=y
CONFIG_ESP_SYSTEM_PANIC_REBOOT_DELAY_SECONDS=0
# brownout detector at LVL 7 (~2.51V) — sensor on solar can dip below
# rail voltage during a cloud transient; reset is safer than corrupt NVS
CONFIG_ESP_BROWNOUT_DET=y
CONFIG_ESP_BROWNOUT_DET_LVL_SEL_7=y
CONFIG_ESP_BROWNOUT_DET_LVL=7
# stack canary catches FreeRTOS task overflows before they corrupt heap
CONFIG_FREERTOS_CHECK_STACKOVERFLOW_CANARY=y
# task watchdog 5s — long enough for slow MQTT TLS handshakes,
# short enough to recover from a wedged radar UART read
CONFIG_ESP_TASK_WDT_EN=y
CONFIG_ESP_TASK_WDT_INIT=y
CONFIG_ESP_TASK_WDT_TIMEOUT_S=5
CONFIG_ESP_TASK_WDT_CHECK_IDLE_TASK_CPU0=y
CONFIG_ESP_INT_WDT=y
CONFIG_ESP_INT_WDT_TIMEOUT_MS=300
# disable debug surfaces in prod images. ESP_GDBSTUB_ENABLED is a
# hidden default-y option that only adds the panic-handler register
# dump — fine to keep. the user-visible runtime gdb stub
# (ESP_SYSTEM_GDBSTUB_RUNTIME) and OCDAWARE are what we don't want
# CONFIG_ESP_SYSTEM_GDBSTUB_RUNTIME is not set
# CONFIG_ESP_DEBUG_OCDAWARE is not set
# skip image SHA validation when waking from deep sleep — the image
# can't change between sleep/wake, and validation costs ~80ms of solar
# budget per wake. matters once dp_sensor moves to deep sleep
CONFIG_BOOTLOADER_SKIP_VALIDATE_IN_DEEP_SLEEP=y
# heap poisoning off — the runtime cost (~10% on alloc/free) doesn't
# pay off in a steady-state firmware that allocates almost nothing
# after init
CONFIG_HEAP_POISONING_DISABLED=y
# coredump to flash needs a coredump partition. partitions.csv doesn't
# have one yet — flip on once the layout adds it. for now, a panic
# triggers PANIC_PRINT_REBOOT and the trace lands in USB-Serial-JTAG
# tools/monitor.sh output
# CONFIG_ESP_COREDUMP_ENABLE_TO_FLASH is not set
CONFIG_ESP_COREDUMP_ENABLE_TO_NONE=y
```
